## sdkconfig.defaults
```kconfig
CONFIG_FREERTOS_HZ=1000
CONFIG_LIBC_NEWLIB=y
CONFIG_ETH_TRANSMIT_MUTEX=y
CONFIG_ETH_DMA_RX_BUFFER_NUM=30
CONFIG_ETH_DMA_TX_BUFFER_NUM=30
CONFIG_ETH_IRAM_OPTIMIZATION=y
CONFIG_COMPILER_OPTIMIZATION_PERF=y
CONFIG_LWIP_IPV4=y
CONFIG_LWIP_IPV6=y
CONFIG_LWIP_MAX_SOCKETS=4
```
